## conf/layer.conf
```bitbake
# meta-ebaz4205 layer configuration
# SPDX-License-Identifier: MIT

BBPATH .= ":${LAYERDIR}"

BBFILES += " \
    ${LAYERDIR}/recipes-*/*/*.bb \
    ${LAYERDIR}/recipes-*/*/*.bbappend \
"

# Make our .wks.in visible to image_types_wic
WKS_SEARCH_PATH .= ":${LAYERDIR}/wic"

BBFILE_COLLECTIONS += "meta-ebaz4205"
BBFILE_PATTERN_meta-ebaz4205 = "^${LAYERDIR}/"
BBFILE_PRIORITY_meta-ebaz4205 = "8"

LAYERDEPENDS_meta-ebaz4205 = "core xilinx xilinx-bsp"
LAYERSERIES_COMPAT_meta-ebaz4205 = "scarthgap"
```
